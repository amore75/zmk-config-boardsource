/*
 * Custom shield overlay for Boardsource 3x4 on SuperMini (XIAO nRF52840)
 * Compatible with ZMK keyboard firmware
 */

#include <dt-bindings/zmk/matrix_transform.h>

/ {
    chosen {
        zmk,kscan = &kscan0;
    };

    kscan0: kscan {
        compatible = "zmk,kscan-gpio-matrix";
        diode-direction = "col2row";
        wakeup-source;

        // 🟦 ROW GPIOs (for 4 rows)
        row-gpios = <&gpio0 6  (GPIO_ACTIVE_HIGH | GPIO_PULL_DOWN)>,
                    <&gpio0 8 (GPIO_ACTIVE_HIGH | GPIO_PULL_DOWN)>,
                    <&gpio0 17 (GPIO_ACTIVE_HIGH | GPIO_PULL_DOWN)>,
                    <&gpio0 20 (GPIO_ACTIVE_HIGH | GPIO_PULL_DOWN)>;

        // 🟥 COLUMN GPIOs (for 3 columns)
        col-gpios = <&gpio0 22 GPIO_ACTIVE_HIGH>,
                    <&gpio0 24 GPIO_ACTIVE_HIGH>,
                    <&gpio0 11 GPIO_ACTIVE_HIGH>;
    };
};
